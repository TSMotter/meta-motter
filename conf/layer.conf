## conf/layer.conf
```bitbake
# We have a conf and classes directory, add to BBPATH
BBPATH .= ":${LAYERDIR}"

# We have recipes-* directories, add to BBFILES
BBFILES += "${LAYERDIR}/recipes-*/*/*.bb \
            ${LAYERDIR}/recipes-*/*/*.bbappend"

BBFILE_COLLECTIONS += "meta-motter"
BBFILE_PATTERN_meta-motter = "^${LAYERDIR}/"
BBFILE_PRIORITY_meta-motter = "6"

LAYERDEPENDS_meta-motter = "core"
LAYERSERIES_COMPAT_meta-motter = "dunfell"
```
